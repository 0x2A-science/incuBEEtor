#include <SPI.h>
#include <Wire.h>
#include "ClosedCube_HDC1080.h"
#include <ESP32Encoder.h>
#include <Adafruit_GFX.h>
#include <Adafruit_SSD1306.h>
#include <EEPROM.h>

#define SCREEN_WIDTH 128 // OLED display width, in pixels
#define SCREEN_HEIGHT 64 // OLED display height, in pixels

// Declaration for an SSD1306 display connected to I2C (SDA, SCL pins)
#define OLED_RESET     -1 // Reset pin # (or -1 if sharing Arduino reset pin)
Adafruit_SSD1306 display(SCREEN_WIDTH, SCREEN_HEIGHT, &Wire, OLED_RESET);

const unsigned char BieneMaja [] PROGMEM = {
  0x00, 0x00, 0x00, 0x00, 0x00, 0x00, 0x00, 0x00, 0x00, 0x00, 0x00, 0x00, 0x00, 0x00, 0x00, 0x00, 
  0x00, 0x00, 0x00, 0x00, 0x00, 0x00, 0x00, 0x00, 0x00, 0x00, 0x00, 0x00, 0x00, 0x00, 0x00, 0x00, 
  0x00, 0x00, 0x00, 0x00, 0x00, 0x00, 0x00, 0x01, 0xc0, 0x00, 0x00, 0x00, 0x00, 0x00, 0x00, 0x00, 
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  0x00, 0x00, 0x00, 0x00, 0x00, 0x00, 0x00, 0x00, 0x00, 0x00, 0x00, 0x00, 0x00, 0x00, 0x00, 0x00
};


ESP32Encoder encoder;

ClosedCube_HDC1080 hdc1080;


float temp;
float humid;
char tempchar[5];
char humidchar[5];

unsigned int set_temp;
unsigned int set_humid;

int enc_inc = 0;
int enc_button_selector = 0;


#define HEATER_UPPER 12
#define HEATER_LOWER 32
#define FAN 14
#define ENC_BUTTON 27
#define ENC_DT 26
#define ENC_CLK 25

void setup()
{
  Serial.begin(115200);
  //initialize EEPROM for persisten temp and humid settings
  EEPROM.begin(16);
  //set output pin modes for relais
  pinMode(HEATER_UPPER, OUTPUT);
  pinMode(HEATER_LOWER, OUTPUT);
  pinMode(FAN, OUTPUT);
  //set outputs to known state
  digitalWrite(FAN, HIGH);
  digitalWrite(HEATER_UPPER, HIGH);
  digitalWrite(HEATER_LOWER, HIGH);
  

  //read stored temperature and humidity values from EEPROM
  set_temp = EEPROM.read(0);
  set_humid = EEPROM.read(1);
  Serial.println(EEPROM.read(0));

  //DISPLAY
 // SSD1306_SWITCHCAPVCC = generate display voltage from 3.3V internally
  if(!display.begin(SSD1306_SWITCHCAPVCC, 0x3C)) { 
    Serial.println(F("SSD1306 allocation failed"));
    for(;;); // Don't proceed, loop forever
  }
 
  //HDC1080
  // Default settings for HDC1080:
  // - Heater off
  // - 14 bit Temperature and Humidity Measurement Resolutions
  hdc1080.begin(0x40);
  Serial.print("Manufacturer ID=0x");
  Serial.println(hdc1080.readManufacturerId(), HEX); // 0x5449 ID of Texas Instruments
  Serial.print("Device ID=0x");
  Serial.println(hdc1080.readDeviceId(), HEX); // 0x1050 ID of the device
  
  
  //ENCODER
  // Enable the weak pull up resistors
  ESP32Encoder::useInternalWeakPullResistors=UP;
  // use pin 19 and 18 for the first encoder
  encoder.attachHalfQuad(ENC_CLK, ENC_DT);
  // set starting count value after attaching
  encoder.setCount(0);
  Serial.println("Encoder Start = " + String((int32_t)encoder.getCount()));

  //ENCODER BUTTON INTERRUPT
  pinMode(ENC_BUTTON, INPUT_PULLUP);
  attachInterrupt(digitalPinToInterrupt(ENC_BUTTON), enc_button_ISR, RISING);

  //print project info to display
  display.clearDisplay();
  display.setTextColor(WHITE); // Draw white text
  display.setTextSize(2);
  display.setCursor(4, 0);
  display.print("incuBEEtor");
  display.setTextSize(1);      // Normal 1:1 pixel scale
  display.setCursor(0, 40);
  display.print("https://github.com/mashuptwice/incuBEEtor");
  display.display();
  delay(1000);
  
  display.clearDisplay();
  // Display logo bitmap
  display.drawBitmap(0, 0,  BieneMaja, 128, 64, WHITE);
  display.display();
  delay(2000);
}
 
void loop()
{
  //get temp and humid and save it to var
  temp = hdc1080.readTemperature();
  humid = hdc1080.readHumidity();

  //round values to 1 decimal
  temp = round(temp*10)/10;
  humid = round(humid*10)/10;

  //initialize display
  display.clearDisplay();       //clear display buffer
  display.setTextSize(1);      // Normal 1:1 pixel scale
  display.setTextColor(WHITE); // Draw white text
  
  //print static text for data to display
  display.setCursor(2, 0);     // Start at top-left corner
  display.print("TEMP.");
  display.setCursor(64, 0);
  display.print("HUMID.");
  display.setCursor(32, 10);

  //print static text for relais info to display
  display.setCursor(8, 52);
  display.print("FAN");
  display.setCursor(58, 52);
  display.print("H1");
  display.setCursor(100, 52);
  display.print("H2");
  
  //print temperature to display
  display.setCursor(2, 12);
  //convert float to char
  dtostrf(temp, 3, 1, tempchar);
  display.print(tempchar);
  //display the degree "°" character
  display.print((char)247);
  display.print("C");

  //print humidity to display
  display.setCursor(64, 12);
  //convert float to char
  dtostrf(humid, 3, 1, humidchar);
  display.print(humidchar);
  display.print("%");

  //print set temp and humid to display
  display.setCursor(2, 30);
  display.print(set_temp);
  //display the degree "°" character
  display.print((char)247);
  display.print("C");

  display.setCursor(64, 30);
  display.print(set_humid);
  display.print("%");

  //get data from encoder as incremental value, dirty fix for using one encoder for two values
  enc_inc = encoder.getCount();

  //mode selector for data input, switches between temperature and humidity
    if (enc_button_selector == 0)
    {
      //draw rectangle to show selected field
      display.drawRect(0, 28, 30, 12, 1);
      
      if (enc_inc != 0)
      { 
        set_temp = constrain(set_temp + enc_inc / 2, 0, 60);
        
        enc_inc = 0;
        encoder.setCount(0);
        
        Serial.println("EEPROM write temp");
        EEPROM.write(0, set_temp);
        EEPROM.commit();
      }
    }
    else if (enc_button_selector == 1)
    {
      //draw rectangle to show selected field
      display.drawRect(62, 28, 30, 12, 1);
      
      //added dirty fix for some bouncing problem with the encoder, which only started to happen after final assembly...
      if (enc_inc != 0)
      {
        set_humid = constrain(set_humid + enc_inc / 2, 0, 100);
        
        enc_inc = 0;
        encoder.setCount(0);
     
        Serial.println("EEPROM write humid");
        EEPROM.write(1, set_humid);
        EEPROM.commit();
        }
      }


  //control routine for heater and fan
  if (round(temp) < set_temp)
  {
    fan(false);
    heater_upper(true);
    heater_lower(true);
    }
  else if (round(temp) > set_temp)
  {
    fan(true);
    heater_upper(false);
    heater_lower(false);
    }
  else if (round(temp) == set_temp)
  {
    if (round(humid) > set_humid)
    {
      fan(true);
      heater_upper(false);
      heater_lower(false);
    }
    else if (round(humid) < set_humid)
    {
      fan(false);
      heater_upper(false);
      heater_lower(true);
    }
    else if (round(humid) == set_humid)
    {
      fan(false);
      heater_upper(false);
      heater_lower(false); 
    }
  }

  //render data to display
  display.display();
  delay(50);
}

void fan( bool en)
  {
    if ( en == true)
    {
      digitalWrite(FAN, LOW);
      display.drawRect(6, 50, 21, 12, 1);
    }
    else
    {
      digitalWrite(FAN, HIGH);
    }
  }

void heater_upper( bool en)
  {
    if ( en == true)
    {
      digitalWrite(HEATER_UPPER, LOW);
      display.drawRect(56, 50, 16, 10, 1);
    }
    else
    {
      digitalWrite(HEATER_UPPER, HIGH);
    }
  }

void heater_lower( bool en)
  {
    if ( en == true)
    {
      digitalWrite(HEATER_LOWER, LOW);
      display.drawRect(98, 50, 16, 10, 1);

    }
    else
    {
      digitalWrite(HEATER_LOWER, HIGH);
    }
  }
//interrupt service routine for encoder button/mode selector
void enc_button_ISR()
{
  Serial.println("ISR triggered");
  static unsigned long last_interrupt_time = 0;
  unsigned long interrupt_time = millis();
  if (interrupt_time - last_interrupt_time > 300)
  {
    enc_button_selector++;
    if (enc_button_selector >= 2)
      {
        enc_button_selector = 0;
      }
    
  }
  last_interrupt_time = interrupt_time;

}

